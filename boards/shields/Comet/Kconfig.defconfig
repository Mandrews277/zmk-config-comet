## boards/shields/Comet/Kconfig.defconfig
```kconfig
if SHIELD_COMET_LEFT

# Name must be less than 16 characters long!
config ZMK_KEYBOARD_NAME
    default "Comet"

config ZMK_SPLIT_ROLE_CENTRAL
    default y

endif

if SHIELD_COMET_LEFT || SHIELD_COMET_RIGHT

config ZMK_SPLIT
    default y

config ZMK_SPLIT_BLE
    default y

endif
```

## boards/shields/Comet/Kconfig.shield
```kconfig
# No whitespace after the comma or in your part name!
config SHIELD_COMET_LEFT
    def_bool $(shields_list_contains,comet_left)

# No whitespace after the comma or in your part name!
config SHIELD_COMET_RIGHT
    def_bool $(shields_list_contains,comet_right)
```

## west.yml
```yaml
manifest:
  remotes:
    - name: zmkfirmware
      url-base: https://github.com/zmkfirmware
    - name: petejohanson
      url-base: https://github.com/petejohanson
  projects:
    - name: zmk
      remote: zmkfirmware
      revision: main
      import: app/west.yml
    - name: zmk-pmw3610-driver
      remote: petejohanson
      revision: pmw3610/main
  self:
    path: config
```
